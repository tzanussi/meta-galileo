## meta-galileo/conf/distro/galileo-micro.conf
```bitbake
require conf/distro/poky-tiny.conf
DISTRO = "galileo-micro"

# poky-tiny forces linux-yocto-tiny otherwise 
PREFERRED_PROVIDER_virtual/kernel = "linux-yocto-micro"
PREFERRED_VERSION_linux-yocto-micro = "3.8%"
PREFERRED_VERSION_ethtool = "3.6%"

VIRTUAL-RUNTIME_dev_manager = "udev"
VIRTUAL-RUNTIME_init_manager = "sysvinit"
VIRTUAL-RUNTIME_initscripts = "initscripts"

DISTRO_FEATURES = "ipv4 ipv6 xattr argp largefile"

TCLIBC = "uclibc"
```

## meta-galileo/conf/distro/poky-micro.conf
```bitbake
require conf/distro/poky-tiny.conf

DISTRO = "poky-micro"
DISTROOVERRIDES = "poky:poky-tiny:${DISTRO}"

PREFERRED_PROVIDER_virtual/kernel = "linux-yocto-micro"
PREFERRED_VERSION_linux-yocto-micro = "3.8%"
PREFERRED_VERSION_ethtool = "3.6%"

VIRTUAL-RUNTIME_init_manager = "sysvinit"
VIRTUAL-RUNTIME_initscripts = "initscripts"

TCLIBC = "uclibc"
```

## meta-galileo/conf/machine/galileo.conf
```bitbake
#@TYPE: Machine
#@NAME: galileo

#@DESCRIPTION: Machine configuration for galileo systems

PREFERRED_PROVIDER_virtual/kernel ?= "linux-yocto-micro"
PREFERRED_VERSION_linux-yocto-micro ?= "3.13%"
#PREFERRED_VERSION_linux-yocto-micro ?= "3.8%"

require conf/machine/include/tune-i586.inc
require conf/machine/include/ia32-base.inc

#Avoid pulling in GRUB
MACHINE_ESSENTIAL_EXTRA_RDEPENDS = ""

MACHINE_FEATURES = "efi usb pci"

SERIAL_CONSOLE = "115200 ttyS1"
#SERIAL_CONSOLES = "115200;ttyS0 115200;ttyS1"

EXTRA_IMAGEDEPENDS = "grub"
PREFERRED_VERSION_grub = "0.97+git%"
```
